## ext-tree/Config.in
```kconfig
source "$BR2_EXTERNAL_AESD_ASSIGNMENTS_PATH/package/aesd-assignments-socket/Config.in"
source "$BR2_EXTERNAL_AESD_ASSIGNMENTS_PATH/package/aesd-assignments-modules/Config.in"
source "$BR2_EXTERNAL_AESD_ASSIGNMENTS_PATH/package/aesd-assignments-devices/Config.in"
source "$BR2_EXTERNAL_AESD_ASSIGNMENTS_PATH/package/aesd-assignments-nopivot-containerd/Config.in"
#source "$BR2_EXTERNAL_AESD_ASSIGNMENTS_PATH/package/libopenssl/Config.in"
#source "$BR2_EXTERNAL_AESD_ASSIGNMENTS_PATH/package/openssl/Config.in"
```

## ext-tree/package/aesd-assignments-nopivot-containerd/Config.in
```kconfig
config BR2_PACKAGE_AESD_ASSIGNMENTS_NOPIVOT_CONTAINERD
	bool "aesd-assignments-nopivot-containerd"
	help
	  AESD nopivot containerd.
```
